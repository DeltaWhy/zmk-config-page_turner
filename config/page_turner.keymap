#include <behaviors.dtsi>
#include <dt-bindings/zmk/bt.h>
#include <dt-bindings/zmk/keys.h>

/ {
    keymap {
        compatible = "zmk,keymap";

        default_layer {
            display-name = "Base";
            bindings = <
  &sl 1
  &kp UP_ARROW  &kp DOWN_ARROW
            >;
        };

        layer_1 {
            bindings = <
  &trans
  &bt BT_CLR  &bootloader
            >;
        };
    };
};
